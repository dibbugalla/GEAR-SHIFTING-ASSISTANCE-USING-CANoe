/*@!Encoding:1252*/
includes
{
 
  
}
  
variables
{
    
}
on message 0xA1
{
  if(this.byte(0)>=0&&this.byte(0)<=10)
  {
    @instrument_cluster::lcd=1;
    @instrument_cluster::analog=this.byte(0);
  }
  else if(this.byte(0)>=11&&this.byte(0)<=20)
  {
    @instrument_cluster::lcd=2;
    @instrument_cluster::analog=this.byte(0);
    
  }
  else if(this.byte(0)>=21&&this.byte(0)<=30)
  {
    @instrument_cluster::lcd=3;
    @instrument_cluster::analog=this.byte(0);
    
  }
  else if(this.byte(0)>=31&&this.byte(0)<=50)
  {
    @instrument_cluster::lcd=4;
    @instrument_cluster::analog=this.byte(0);
    
  }
  else if(this.byte(0)>50)
  {
    @instrument_cluster::lcd=5;
    @instrument_cluster::analog=this.byte(0);
    
  }
  else;
}
on preStop
{
  @instrument_cluster::lcd=0;
    @instrument_cluster::analog=0;
}